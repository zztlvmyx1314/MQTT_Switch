
#include "mqtt.h"

#include "esp8266.h"
#include "tim.h"



uint8_t MQTT_Buf[RxBufSize]={0};

uint8_t Ping=0;

uint8_t PING[]={0xc0,0x00,'>'};

uint8_t PINGACK[]={0xd0,00,'>'};

uint8_t SUBACK[]={0x90,0x03,0x00,0x01,0x01,'>'};

uint8_t CONNACK[]={0x20,0x02,0x00,0x00,'>'};

uint8_t MQTTCONN[]=
{0x10,0x76,0x00,0x04,0x4d,0x51,0x54,0x54,0x04,0xc2,0x00,0x3c,0x00,0x27,0x31,0x32,
0x33,0x34,0x35,0x7c,0x73,0x65,0x63,0x75,0x72,0x65,0x6d,0x6f,0x64,0x65,0x3d,0x33,
0x2c,0x73,0x69,0x67,0x6e,0x6d,0x65,0x74,0x68,0x6f,0x64,0x3d,0x68,0x6d,0x61,0x63,
0x73, 0x68,0x61,0x31,0x7c,0x00,0x17,0x4c,0x61,0x6d,0x70,0x5f,0x53,0x77,0x69,0x74,
0x63,0x68,0x26,0x61,0x31,0x31,0x39,0x70,0x48,0x51,0x45,0x46,0x53,0x72,0x00,0x28,
0x43,0x43,0x42,0x30,0x36,0x42,0x45,0x32,0x33,0x38,0x46,0x32,0x46,0x38,0x30,0x46,
0x35,0x46,0x43,0x46,0x45,0x30,0x35,0x34,0x31,0x44,0x35,0x44,0x30,0x46,0x35,0x45,
0x32,0x38,0x46,0x35,0x32,0x44,0x30,0x32,'>'
};

uint8_t MQTTSUB[]={0x82,0x2a,0x00,0x01,0x00,0x25,0x2f,0x61,0x31,0x31,0x39,0x70,0x48,0x51,0x45,0x46,
0x53,0x72,0x2f,0x4c,0x61,0x6d,0x70,0x5f,0x53,0x77,0x69,0x74,0x63,0x68,0x2f,0x75,
0x73,0x65,0x72,0x2f,0x6f,0x6e,0x6f,0x72,0x6f,0x66,0x66,0x00,'>'};

uint8_t M1OFF[]={0x3d,0x31,0x30,'>'};
uint8_t M1ON[]={0x3d,0x31,0x31,'>'};

uint8_t M2OFF[]={0x3d,0x32,0x30,'>'};
uint8_t M2ON[]={0x3d,0x32,0x31,'>'};

void MQTT_Init(){

	 Ping=0;  
	
   MQTT_Mes(MQTTCONN,CONNACK);
	
	 MQTT_Mes(MQTTSUB,SUBACK);
      
   MQTTPING(30); // 15秒PING一次
   
	 


}

void MQTTPING(uint16_t interval){

     TIM_Init(TIM_2,interval);
     



}

void MQTT_SPing(){

	  if(Ping!=0){
		
			MQTT_Mes(PING,PINGACK);
			
//				HAL_UART_Transmit(&UART2_Handler,(uint8_t*)PING,2,0xffff);
			
			Ping=0;
			
		}
     

}


void MQTT_Mes(uint8_t* data,uint8_t* mqttack){

     uint16_t num=MesLen(data);
	
	 char* ack="OK";
     
	   uint8_t count=4;
	
	  do {
		 
		  
			printf("AT+CIPSEND=%d\r\n",num);
	
	    HAL_Delay(500);
			 
//			if(ESP_CheckBack(ack)==Success){
//			
//				break;
//			}
			
			 
		 
		 } while((--count)&&(!ESP_CheckBack(ack)));
	
    count=4;
		 ack="SEND OK";
		 
		 do {
		 
		  
			HAL_UART_Transmit(&UART1_Handler,(uint8_t*)data,num,0xffff);
	
	    HAL_Delay(500);
			 
//			if(ESP_CheckBack(ack)==Success){
//			
//				return;
//			}
//			!ESP_CheckBack(ack))&&
			 
		 
		 } while((--count)&&(!ESP_CheckBack(ack))&&(!MQTT_TestBack(mqttack)));

}




uint8_t MQTT_TestBack(uint8_t ack[]){

         uint16_t len=MesLen(ack);
	
         uint8_t count=4;
	
	       uint8_t *ch=memchr(MQTT_Buf,ack[0],RxBufSize);
//	       memset(MQTT_Buf,0,RxBufSize);
		 
		 while((--count)&&(memcmp(ch,ack,len)!=0)){}

     if(count!=0){
		 
			 
			 return Success;
			 
		 }
		 
		 else{
		 
			 return Failure;
			 
		 }







}




uint16_t MesLen(uint8_t mes[]){

	    
	    uint16_t i=0;
	
     while(mes[i]!='>'){
		 
			  
		     
		    i++;
		 
		 }
	
   return i;

}


uint8_t MQTT_DataDeal()   // MQTT数据处理函数
{

     uint8_t flag=0;
	   
//		
	   
      
		if(MQTT_TestBack(M1ON)){
		
//			 USART_IsEnable(OFF); 
			 memset(MQTT_Buf,0,RxBufSize);		
			 return 0x11;
		
		
		}
		
		else if(MQTT_TestBack(M1OFF)){
		
//			  USART_IsEnable(OFF); 
			 memset(MQTT_Buf,0,RxBufSize); 
		  return 0x10;	  
		
		}
		
		 if(MQTT_TestBack(M2OFF)){
		
//			   USART_IsEnable(OFF); 
			 memset(MQTT_Buf,0,RxBufSize);

		  return 0x20;	  
		
		}
		
		else if(MQTT_TestBack(M2ON)){
		
//			   USART_IsEnable(OFF); 
			 memset(MQTT_Buf,0,RxBufSize);

		  return 0x21;	  
		  
			
		}
		
 
	 
	
		
//		USART_IsEnable(ON); 
		
	
		
}
